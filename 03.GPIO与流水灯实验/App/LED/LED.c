/*********************************************************************************************************
* 模块名称：
* 摘    要：
* 当前版本：1.0.0
* 作    者：SZLY(COPYRIGHT 2018 - 2020 SZLY. All rights reserved.)
* 完成日期：2020年01月01日  
* 内    容：
* 注    意：                                                                  
**********************************************************************************************************
* 取代版本：
* 作    者：
* 完成日期：
* 修改内容：
* 修改文件：
*********************************************************************************************************/

/*********************************************************************************************************
*                                              包含头文件
*********************************************************************************************************/
#include "LED.h"
#include "stm32f10x_gpio.h"

/*********************************************************************************************************
*                                              宏定义
*********************************************************************************************************/

/*********************************************************************************************************
*                                              枚举结构体定义
*********************************************************************************************************/

/*********************************************************************************************************
*                                              内部变量
*********************************************************************************************************/
 
/*********************************************************************************************************
*                                              内部函数声明
*********************************************************************************************************/
static void ConfigLEDGPIO(void);
/*********************************************************************************************************
*                                              内部函数实现
*********************************************************************************************************/
/*********************************************************************************************************
* 函数名称：ConfigLEDGPIO(void)
* 函数功能：
* 输入参数：
* 输出参数：
* 返 回 值：
* 创建日期：2018年01月01日
* 注    意：
*********************************************************************************************************/
static void ConfigLEDGPIO(void)
{
  GPIO_InitTypeDef GPIO_InitStruct;
  
  RCC_APB2PeriphClockCmd(RCC_APB2Periph_GPIOC,ENABLE);
  GPIO_InitStruct.GPIO_Pin = GPIO_Pin_4;
  GPIO_InitStruct.GPIO_Mode = GPIO_Mode_Out_PP;
  GPIO_InitStruct.GPIO_Speed = GPIO_Speed_50MHz;
  GPIO_Init(GPIOC,&GPIO_InitStruct);
  
  GPIO_WriteBit(GPIOC,GPIO_Pin_4,Bit_RESET);
  
  GPIO_InitStruct.GPIO_Pin = GPIO_Pin_5;
  GPIO_InitStruct.GPIO_Mode = GPIO_Mode_Out_PP;
  GPIO_InitStruct.GPIO_Speed = GPIO_Speed_50MHz;
  GPIO_Init(GPIOC,&GPIO_InitStruct);
  
  GPIO_WriteBit(GPIOC,GPIO_Pin_5,Bit_RESET);
  
}


/*********************************************************************************************************
*                                              API函数实现
*********************************************************************************************************/
/*********************************************************************************************************
* 函数名称：
* 函数功能：
* 输入参数：
* 输出参数：
* 返 回 值：
* 创建日期：2018年01月01日
* 注    意：
*********************************************************************************************************/
void InitLED(void)
{
  ConfigLEDGPIO();
}

//cnt赋值500
void LEDFlicker(u16 cnt)
{
  static u16 s_iCnt;
  static u8 lastPhase = 0;        
  u8 currentPhase;                
  
  // 计算当前阶段（0-3）
  if (s_iCnt < cnt)
  {
    currentPhase = 0;  
  }
  else if (s_iCnt < 2 * cnt)
  {
    currentPhase = 1;  
  }
  else if (s_iCnt < 3 * cnt)
  {
    currentPhase = 2;  
  }
  else
  {
    currentPhase = 3;  
  }
  
  // 只有当当前阶段与上一次不同时，才更新LED状态（只调用一次）
  if (currentPhase != lastPhase)
  {
    switch(currentPhase)
    {
      case 0:  // 第一阶段：两灯均灭
        GPIO_WriteBit(GPIOC, GPIO_Pin_4, Bit_RESET);
        GPIO_WriteBit(GPIOC, GPIO_Pin_5, Bit_RESET);
        break;
      case 1:  // 第二阶段：LED1灭，LED2亮
        GPIO_WriteBit(GPIOC, GPIO_Pin_4, Bit_RESET);
        GPIO_WriteBit(GPIOC, GPIO_Pin_5, Bit_SET);
        break;
      case 2:  // 第三阶段：LED1亮，LED2灭
        GPIO_WriteBit(GPIOC, GPIO_Pin_4, Bit_SET);
        GPIO_WriteBit(GPIOC, GPIO_Pin_5, Bit_RESET);
        break;
      case 3:  // 第四阶段：两灯均亮
        GPIO_WriteBit(GPIOC, GPIO_Pin_4, Bit_SET);
        GPIO_WriteBit(GPIOC, GPIO_Pin_5, Bit_SET);
        break;
    }
    lastPhase = currentPhase;  // 更新上一次阶段记录
  }
  
  // 计数器递增，超过4*cnt后重置
  s_iCnt++;
  if (s_iCnt >= 4 * cnt)
  {
    s_iCnt = 0;
  }
}


